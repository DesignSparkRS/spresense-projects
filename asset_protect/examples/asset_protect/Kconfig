## asset_protect/examples/asset_protect/Kconfig
```kconfig
#
# For a description of the syntax of this configuration file,
# see the file kconfig-language.txt in the NuttX tools repository.
#

config EXAMPLES_ASSET_PROTECT
	bool "Asset Protect application"
	default n
	---help---
		Enable the sensor via SCU Mathfunc example

if EXAMPLES_ASSET_PROTECT

config EXAMPLES_ASSET_PROTECT_PROGNAME
	string "Program name"
	default "asset_protect"
	depends on BUILD_KERNEL
	---help---
		This is the name of the program that will be use when the NSH ELF
		program is installed.

config EXAMPLES_ASSET_PROTECT_PRIORITY
	int "Sensor task priority"
	default 100

config EXAMPLES_ASSET_PROTECT_STACKSIZE
	int "Sensor stack size"
	default 2048

config EXAMPLES_ASSET_PROTECT_FILEPATH
	string "path to save the log file"
	default "/mnt/spif/ASSETLOG"

endif
```

## asset_protect/sdk/configs/examples/asset_protect-defconfig
```kconfig
CONFIG_CXD56_I2C0=y
CONFIG_CXD56_GNSS=y
CONFIG_GPSUTILS_CXD56NMEA_LIB=y
CONFIG_SENSORS=y
CONFIG_BMI160=y
CONFIG_BMI160_I2C=y
CONFIG_EXAMPLES_ASSET_PROTECT=y
```
